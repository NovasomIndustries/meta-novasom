## conf/machine/novasom-m7-sd.conf
```bitbake
# Copyright (C) 2019 Novasis Ingegneria Srl
# Author: Paolo Geninatti <tech@pagit.eu>
#
# Yocto machine configuration for Novasom M7 board
#  with boot from SD card

#@TYPE: Machine
#@NAME: Novasom M7 SD

include conf/machine/include/rk3328.inc

PREFERRED_VERSION_linux-rockchip = "4.4.103"

SERIAL_CONSOLES = "115200;ttyFIQ0"
KERNEL_IMAGETYPE = "Image"
KERNEL_DEVICETREE = "rockchip/rk3328-novasom-m7.dtb"

unset KBUILD_DEFCONFIG

UBOOT_MACHINE = "novasom-m7_defconfig"
```
